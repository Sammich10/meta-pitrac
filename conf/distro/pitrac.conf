## conf/distro/pitrac.conf
```bitbake
require conf/distro/poky.conf

DISTRO = "pitrac"
DISTRO_NAME = "PiTrac Distro"
SDK_VENDOR = "-pitracsdk"
TARGET_VENDOR = "-pitrac"

DISTRO_FEATURES:append = " pam libpam nfs usrmerge systemd"

MACHINE_FEATURES:append = " pitft"

# Enable systemd support
VIRTUAL-RUNTIME_dev_manager = "systemd"
VIRTUAL-RUNTIME_init_manager = "systemd"
VIRTUAL-RUNTIME_initscript = ""
VIRTUAL-RUNTIME_syslog = "systemd"
DISTRO_FEATURES_BACKFILL_CONSIDERED += "sysvinit"

LICENSE_FLAGS_ACCEPTED:append = " synaptics-killswitch commercial"

# Use same kernel version as Raspberry Pi OS for better hardware support (Bullseye)
PREFERRED_VERSION_linux-raspberrypi = "6.12%"
# Use a specific version of rpicam-apps that is compatible with libcamera
PREFERRED_VERSION_rpicam-apps = "1.5.3"

RPI_KERNEL_DEVICETREE_OVERLAYS:append = " overlays/imx296.dtbo"

ENABLE_SPI_BUS = "1"
ENABLE_I2C = "1"
ENABLE_UART = "1"
VIDEO_CAMERA = "1"
GPU_MEM = "128"

# Auto-load required modules
KERNEL_MODULE_AUTOLOAD:append = " i2c-dev i2c-bcm2835"

# Add extra config.txt settings
RPI_EXTRA_CONFIG:append = "\n# Camera auto-detection\ncamera_auto_detect=0\n"
RPI_EXTRA_CONFIG:append = "\n# Run as fast as firmware/board allows\n"
RPI_EXTRA_CONFIG:append = "\narm_boost=1\n"
RPI_EXTRA_CONFIG:append = "\n# Enable Sony IMX296 camera(s) support\n"
RPI_EXTRA_CONFIG:append = "\ndtoverlay=imx296,always-on,cam0\n"
RPI_EXTRA_CONFIG:append = "\ndtoverlay=imx296,always-on\n"

# Set custom hostname
hostname:pn-base-files = "pitrac-pi"
HOSTNAME = "pitrac-pi"
```
